/dts-v1/;

// This is a dummy Linux device tree, just needed to make some bootloaders
// that expect a device tree happy.
/ {
    model = "dummy";

    // We need these nodes so bootloaders can add extra information here.
    chosen {
    	linux,initrd-start = <0x0 0x41000000>;
    };
    memory {};
};
